## meta-pi/conf/layer.conf
```bitbake
# We have a conf and classes directory, append to BBPATH
BBPATH .= ":${LAYERDIR}"

# We have a recipes directory containing .bb and .bbappend files, add to BBFILES
BBFILES += "${LAYERDIR}/recipes*/*/*.bb ${LAYERDIR}/recipes*/*/*.bbappend ${LAYERDIR}/images/*.bb"

BBFILE_COLLECTIONS += "meta-pi"
BBFILE_PATTERN_meta-pi := "^${LAYERDIR}/"
BBFILE_PRIORITY_meta-pi = "16"

LAYERSERIES_COMPAT_meta-pi = "kirkstone langdale"
```
